/*
  Wifi secure connection example for ESP32
  Running on TLS 1.2 using mbedTLS
  Suporting the following chipersuites:
  "TLS_ECDHE_ECDSA_WITH_AES_256_GCM_SHA384","TLS_ECDHE_RSA_WITH_AES_256_GCM_SHA384","TLS_DHE_RSA_WITH_AES_256_GCM_SHA384","TLS_ECDHE_ECDSA_WITH_AES_256_CCM","TLS_DHE_RSA_WITH_AES_256_CCM","TLS_ECDHE_ECDSA_WITH_AES_256_CBC_SHA384","TLS_ECDHE_RSA_WITH_AES_256_CBC_SHA384","TLS_DHE_RSA_WITH_AES_256_CBC_SHA256","TLS_ECDHE_ECDSA_WITH_AES_256_CBC_SHA","TLS_ECDHE_RSA_WITH_AES_256_CBC_SHA","TLS_DHE_RSA_WITH_AES_256_CBC_SHA","TLS_ECDHE_ECDSA_WITH_AES_256_CCM_8","TLS_DHE_RSA_WITH_AES_256_CCM_8","TLS_ECDHE_ECDSA_WITH_CAMELLIA_256_GCM_SHA384","TLS_ECDHE_RSA_WITH_CAMELLIA_256_GCM_SHA384","TLS_DHE_RSA_WITH_CAMELLIA_256_GCM_SHA384","TLS_ECDHE_ECDSA_WITH_CAMELLIA_256_CBC_SHA384","TLS_ECDHE_RSA_WITH_CAMELLIA_256_CBC_SHA384","TLS_DHE_RSA_WITH_CAMELLIA_256_CBC_SHA256","TLS_DHE_RSA_WITH_CAMELLIA_256_CBC_SHA","TLS_ECDHE_ECDSA_WITH_AES_128_GCM_SHA256","TLS_ECDHE_RSA_WITH_AES_128_GCM_SHA256","TLS_DHE_RSA_WITH_AES_128_GCM_SHA256","TLS_ECDHE_ECDSA_WITH_AES_128_CCM","TLS_DHE_RSA_WITH_AES_128_CCM","TLS_ECDHE_ECDSA_WITH_AES_128_CBC_SHA256","TLS_ECDHE_RSA_WITH_AES_128_CBC_SHA256","TLS_DHE_RSA_WITH_AES_128_CBC_SHA256","TLS_ECDHE_ECDSA_WITH_AES_128_CBC_SHA","TLS_ECDHE_RSA_WITH_AES_128_CBC_SHA","TLS_DHE_RSA_WITH_AES_128_CBC_SHA","TLS_ECDHE_ECDSA_WITH_AES_128_CCM_8","TLS_DHE_RSA_WITH_AES_128_CCM_8","TLS_ECDHE_ECDSA_WITH_CAMELLIA_128_GCM_SHA256","TLS_ECDHE_RSA_WITH_CAMELLIA_128_GCM_SHA256","TLS_DHE_RSA_WITH_CAMELLIA_128_GCM_SHA256","TLS_ECDHE_ECDSA_WITH_CAMELLIA_128_CBC_SHA256","TLS_ECDHE_RSA_WITH_CAMELLIA_128_CBC_SHA256","TLS_DHE_RSA_WITH_CAMELLIA_128_CBC_SHA256","TLS_DHE_RSA_WITH_CAMELLIA_128_CBC_SHA","TLS_ECDHE_ECDSA_WITH_3DES_EDE_CBC_SHA","TLS_ECDHE_RSA_WITH_3DES_EDE_CBC_SHA","TLS_DHE_RSA_WITH_3DES_EDE_CBC_SHA","TLS_DHE_PSK_WITH_AES_256_GCM_SHA384","TLS_DHE_PSK_WITH_AES_256_CCM","TLS_ECDHE_PSK_WITH_AES_256_CBC_SHA384","TLS_DHE_PSK_WITH_AES_256_CBC_SHA384","TLS_ECDHE_PSK_WITH_AES_256_CBC_SHA","TLS_DHE_PSK_WITH_AES_256_CBC_SHA","TLS_DHE_PSK_WITH_CAMELLIA_256_GCM_SHA384","TLS_ECDHE_PSK_WITH_CAMELLIA_256_CBC_SHA384","TLS_DHE_PSK_WITH_CAMELLIA_256_CBC_SHA384","TLS_PSK_DHE_WITH_AES_256_CCM_8","TLS_DHE_PSK_WITH_AES_128_GCM_SHA256","TLS_DHE_PSK_WITH_AES_128_CCM","TLS_ECDHE_PSK_WITH_AES_128_CBC_SHA256","TLS_DHE_PSK_WITH_AES_128_CBC_SHA256","TLS_ECDHE_PSK_WITH_AES_128_CBC_SHA","TLS_DHE_PSK_WITH_AES_128_CBC_SHA","TLS_DHE_PSK_WITH_CAMELLIA_128_GCM_SHA256","TLS_DHE_PSK_WITH_CAMELLIA_128_CBC_SHA256","TLS_ECDHE_PSK_WITH_CAMELLIA_128_CBC_SHA256","TLS_PSK_DHE_WITH_AES_128_CCM_8","TLS_ECDHE_PSK_WITH_3DES_EDE_CBC_SHA","TLS_DHE_PSK_WITH_3DES_EDE_CBC_SHA","TLS_RSA_WITH_AES_256_GCM_SHA384","TLS_RSA_WITH_AES_256_CCM","TLS_RSA_WITH_AES_256_CBC_SHA256","TLS_RSA_WITH_AES_256_CBC_SHA","TLS_ECDH_RSA_WITH_AES_256_GCM_SHA384","TLS_ECDH_RSA_WITH_AES_256_CBC_SHA384","TLS_ECDH_RSA_WITH_AES_256_CBC_SHA","TLS_ECDH_ECDSA_WITH_AES_256_GCM_SHA384","TLS_ECDH_ECDSA_WITH_AES_256_CBC_SHA384","TLS_ECDH_ECDSA_WITH_AES_256_CBC_SHA","TLS_RSA_WITH_AES_256_CCM_8","TLS_RSA_WITH_CAMELLIA_256_GCM_SHA384","TLS_RSA_WITH_CAMELLIA_256_CBC_SHA256","TLS_RSA_WITH_CAMELLIA_256_CBC_SHA","TLS_ECDH_RSA_WITH_CAMELLIA_256_GCM_SHA384","TLS_ECDH_RSA_WITH_CAMELLIA_256_CBC_SHA384","TLS_ECDH_ECDSA_WITH_CAMELLIA_256_GCM_SHA384","TLS_ECDH_ECDSA_WITH_CAMELLIA_256_CBC_SHA384","TLS_RSA_WITH_AES_128_GCM_SHA256","TLS_RSA_WITH_AES_128_CCM","TLS_RSA_WITH_AES_128_CBC_SHA256","TLS_RSA_WITH_AES_128_CBC_SHA","TLS_ECDH_RSA_WITH_AES_128_GCM_SHA256","TLS_ECDH_RSA_WITH_AES_128_CBC_SHA256","TLS_ECDH_RSA_WITH_AES_128_CBC_SHA","TLS_ECDH_ECDSA_WITH_AES_128_GCM_SHA256","TLS_ECDH_ECDSA_WITH_AES_128_CBC_SHA256","TLS_ECDH_ECDSA_WITH_AES_128_CBC_SHA","TLS_RSA_WITH_AES_128_CCM_8","TLS_RSA_WITH_CAMELLIA_128_GCM_SHA256","TLS_RSA_WITH_CAMELLIA_128_CBC_SHA256","TLS_RSA_WITH_CAMELLIA_128_CBC_SHA","TLS_ECDH_RSA_WITH_CAMELLIA_128_GCM_SHA256","TLS_ECDH_RSA_WITH_CAMELLIA_128_CBC_SHA256","TLS_ECDH_ECDSA_WITH_CAMELLIA_128_GCM_SHA256","TLS_ECDH_ECDSA_WITH_CAMELLIA_128_CBC_SHA256","TLS_RSA_WITH_3DES_EDE_CBC_SHA","TLS_ECDH_RSA_WITH_3DES_EDE_CBC_SHA","TLS_ECDH_ECDSA_WITH_3DES_EDE_CBC_SHA","TLS_RSA_PSK_WITH_AES_256_GCM_SHA384","TLS_RSA_PSK_WITH_AES_256_CBC_SHA384","TLS_RSA_PSK_WITH_AES_256_CBC_SHA","TLS_RSA_PSK_WITH_CAMELLIA_256_GCM_SHA384","TLS_RSA_PSK_WITH_CAMELLIA_256_CBC_SHA384","TLS_RSA_PSK_WITH_AES_128_GCM_SHA256","TLS_RSA_PSK_WITH_AES_128_CBC_SHA256","TLS_RSA_PSK_WITH_AES_128_CBC_SHA","TLS_RSA_PSK_WITH_CAMELLIA_128_GCM_SHA256","TLS_RSA_PSK_WITH_CAMELLIA_128_CBC_SHA256","TLS_RSA_PSK_WITH_3DES_EDE_CBC_SHA","TLS_PSK_WITH_AES_256_GCM_SHA384","TLS_PSK_WITH_AES_256_CCM","TLS_PSK_WITH_AES_256_CBC_SHA384","TLS_PSK_WITH_AES_256_CBC_SHA","TLS_PSK_WITH_CAMELLIA_256_GCM_SHA384","TLS_PSK_WITH_CAMELLIA_256_CBC_SHA384","TLS_PSK_WITH_AES_256_CCM_8","TLS_PSK_WITH_AES_128_GCM_SHA256","TLS_PSK_WITH_AES_128_CCM","TLS_PSK_WITH_AES_128_CBC_SHA256","TLS_PSK_WITH_AES_128_CBC_SHA","TLS_PSK_WITH_CAMELLIA_128_GCM_SHA256","TLS_PSK_WITH_CAMELLIA_128_CBC_SHA256","TLS_PSK_WITH_AES_128_CCM_8","TLS_PSK_WITH_3DES_EDE_CBC_SHA","TLS_EMPTY_RENEGOTIATION_INFO_SCSV"]
  2017 - Evandro Copercini - Apache 2.0 License.
*/

#include <WiFiClientSecure.h>

const char *ssid = "CSW-Guest";      // your network SSID (name of wifi network)
const char *password = "Critical98"; // your network password

const char *server = "a1yj9lgdqxsds2-ats.iot.eu-west-2.amazonaws.com"; // Server URL

// www.howsmyssl.com root certificate authority, to verify the server
// change it to your server root CA
// SHA1 fingerprint is broken now!

const char *test_root_ca =
    "-----BEGIN CERTIFICATE-----\n"
    "MIIDQTCCAimgAwIBAgITBmyfz5m/jAo54vB4ikPmljZbyjANBgkqhkiG9w0BAQsF\n"
    "ADA5MQswCQYDVQQGEwJVUzEPMA0GA1UEChMGQW1hem9uMRkwFwYDVQQDExBBbWF6\n"
    "b24gUm9vdCBDQSAxMB4XDTE1MDUyNjAwMDAwMFoXDTM4MDExNzAwMDAwMFowOTEL\n"
    "MAkGA1UEBhMCVVMxDzANBgNVBAoTBkFtYXpvbjEZMBcGA1UEAxMQQW1hem9uIFJv\n"
    "b3QgQ0EgMTCCASIwDQYJKoZIhvcNAQEBBQADggEPADCCAQoCggEBALJ4gHHKeNXj\n"
    "ca9HgFB0fW7Y14h29Jlo91ghYPl0hAEvrAIthtOgQ3pOsqTQNroBvo3bSMgHFzZM\n"
    "9O6II8c+6zf1tRn4SWiw3te5djgdYZ6k/oI2peVKVuRF4fn9tBb6dNqcmzU5L/qw\n"
    "IFAGbHrQgLKm+a/sRxmPUDgH3KKHOVj4utWp+UhnMJbulHheb4mjUcAwhmahRWa6\n"
    "VOujw5H5SNz/0egwLX0tdHA114gk957EWW67c4cX8jJGKLhD+rcdqsq08p8kDi1L\n"
    "93FcXmn/6pUCyziKrlA4b9v7LWIbxcceVOF34GfID5yHI9Y/QCB/IIDEgEw+OyQm\n"
    "jgSubJrIqg0CAwEAAaNCMEAwDwYDVR0TAQH/BAUwAwEB/zAOBgNVHQ8BAf8EBAMC\n"
    "AYYwHQYDVR0OBBYEFIQYzIU07LwMlJQuCFmcx7IQTgoIMA0GCSqGSIb3DQEBCwUA\n"
    "A4IBAQCY8jdaQZChGsV2USggNiMOruYou6r4lK5IpDB/G/wkjUu0yKGX9rbxenDI\n"
    "U5PMCCjjmCXPI6T53iHTfIUJrU6adTrCC2qJeHZERxhlbI1Bjjt/msv0tadQ1wUs\n"
    "N+gDS63pYaACbvXy8MWy7Vu33PqUXHeeE6V/Uq2V8viTO96LXFvKWlJbYK8U90vv\n"
    "o/ufQJVtMVT8QtPHRh8jrdkPSHCa2XV4cdFyQzR1bldZwgJcJmApzyMZFo6IQ6XU\n"
    "5MsI+yMRQ+hDKXJioaldXgjUkK642M4UwtBV8ob2xJNDd2ZhwLnoQdeXeGADbkpy\n"
    "rqXRfboQnoZsG4q5WTP468SQvvG5\n"
    "-----END CERTIFICATE-----";

// You can use x.509 client certificates if you want
const char *test_client_key =
    "-----BEGIN CERTIFICATE-----\n"
    "MIIDWjCCAkKgAwIBAgIVAIFuWtYDwa/K/5PTjAmjp/Oe0eZZMA0GCSqGSIb3DQEB\n"
    "CwUAME0xSzBJBgNVBAsMQkFtYXpvbiBXZWIgU2VydmljZXMgTz1BbWF6b24uY29t\n"
    "IEluYy4gTD1TZWF0dGxlIFNUPVdhc2hpbmd0b24gQz1VUzAeFw0yMjA4MDQxMzUx\n"
    "NTlaFw00OTEyMzEyMzU5NTlaMB4xHDAaBgNVBAMME0FXUyBJb1QgQ2VydGlmaWNh\n"
    "dGUwggEiMA0GCSqGSIb3DQEBAQUAA4IBDwAwggEKAoIBAQCvyUMU22Hhpf9gCwcy\n"
    "0+8F75hw5PsjokG7TN7W7Nhz2OSnTjJpSzNuTDC1bY0py5n9kFEGJU3Ejv7MESEq\n"
    "K5gQNuDacqPtCjpTsJIYq8LXil4UOEuBB2juwash2IiLdkrEnwMnBhfwKlw+2znN\n"
    "BXoCnhL5QAbsI09NO1zosPTCP31NeODBDlcczmchJr7sMD9mahv97qwsqNTjImV2\n"
    "3dtDNqtQXL8h/oBmebIu2GBgRD+QgeN6xil4PUR9m0bX+yNHP0y/0FTWApWheeKp\n"
    "hSW/usUhMwvxGI67ok+1SHfd7N6SdcJ06KWK0thjmFVJFQjpp9yXOxZ/563oyNew\n"
    "0PYDAgMBAAGjYDBeMB8GA1UdIwQYMBaAFAYs8aerIJhJ5KXOPs+TNM4cKd08MB0G\n"
    "A1UdDgQWBBSyW5VD2PoQUngABgXlzB1McyeSVzAMBgNVHRMBAf8EAjAAMA4GA1Ud\n"
    "DwEB/wQEAwIHgDANBgkqhkiG9w0BAQsFAAOCAQEAYPRzqEpJGjkoxrD9utRpZIUN\n"
    "gsf++kQQov9Th8eJRtt71uXzWnrvBQpiLqei851+F3KZXLBpTwl6X8kuvzmbba+J\n"
    "3gx0Wrjsge3uNkVzs8neez0Y33zReD0oM7VGembqk34Quhlg3mAaMf2KaXZy2t5h\n"
    "xlTOfl8NQEJwbAxfGi0uYjm+5O7g9ntMjHYeHPbQ5JJZa7Nn845/VFvfxOWFUH+q\n"
    "PonHdEmR0aR9aooo8QHGFfchG24lCaatzh1zZmC/ZRexmvslbaPYcAUQIYIsOAyg\n"
    "7gX68i4j9BBfEKaR6CZe2tcdbobwlPsIFznS9bAWiuhaxUm5tOcAMEC/CKVUUg==\n"
    "-----END CERTIFICATE-----";

const char *test_client_cert =
    "-----BEGIN RSA PRIVATE KEY-----\n"
    "MIIEpAIBAAKCAQEAr8lDFNth4aX/YAsHMtPvBe+YcOT7I6JBu0ze1uzYc9jkp04y\n"
    "aUszbkwwtW2NKcuZ/ZBRBiVNxI7+zBEhKiuYEDbg2nKj7Qo6U7CSGKvC14peFDhL\n"
    "gQdo7sGrIdiIi3ZKxJ8DJwYX8CpcPts5zQV6Ap4S+UAG7CNPTTtc6LD0wj99TXjg\n"
    "wQ5XHM5nISa+7DA/Zmob/e6sLKjU4yJldt3bQzarUFy/If6AZnmyLthgYEQ/kIHj\n"
    "esYpeD1EfZtG1/sjRz9Mv9BU1gKVoXniqYUlv7rFITML8RiOu6JPtUh33ezeknXC\n"
    "dOilitLYY5hVSRUI6afclzsWf+et6MjXsND2AwIDAQABAoIBAQCdwZJpImUae73O\n"
    "tLb2H4rQGfEFyAm2NgSlkdweqBmtBcZWe2/0XN/AKbJA8BsSmj0NeTmtuUaskuQJ\n"
    "wYmw7cSfMJDkmqOQtHAZ8Ul7yJGom+3IWakxF7RNKRNq4YfRGQ0KneXXXLmY+Hsm\n"
    "kdmyrCqONMy0UYik3R9rIU5FKaHOvGu4qnIw1V/FfJMLBdM5XOXj5ypvy9NnQJiX\n"
    "OfTGxkbqWOrsP/AvnIOhvbPwGXCUi0gWTyul2HVIHfAEjLtTNe5acVYj8tdUxjJN\n"
    "8X56z1mi6pNYdUC5uwA8C0zyMFCMwkIRMNtcmCGIIAblDhrUF/Oo265gM7ujIvm+\n"
    "k4nJ+DLxAoGBAOX07GGdVQS9sQYZYCHgzusPf/aHtjCRwL8c8dMr0V9IDMVlgQSg\n"
    "q8da2nUwCRnQ6y87J5Xoi5i0ELlaY3b8YQkPfElddZ+MhQBQNJELq1sxhNjm+zP7\n"
    "oiUwEsBM3aEH6fGAKEsrg0EZDPLKrPeqyspte2+m7jU8Ga30zP1C5QwLAoGBAMOx\n"
    "ySWWWRY5H50tQcUj294zhezvMTIWvSs2L1XWFseVZl44FDXyn5kS/48c6kj8BCvz\n"
    "39v9Pfo3CfqKgc2IpOCH4K2fgSh3040/QHNjKR2xpzdcxWULi21MA68flWi5CWvC\n"
    "9pJtgNteyNAjdZRkFmw4DsdcWXxhUTS/gdspqwDpAoGAMd3/NNvth+2q6euu0Snz\n"
    "NT5TPZ8If1fcOJWKS4UBDmyNeHEenWZKWhz1qtwT3SlVFxT47KVVQHQr/EYBs9ff\n"
    "Ixvck/xUeZj7bqn1/E5PhqMib/cHGqrC6tWV+2Wv2i/hJ6HnGwYAnKlWCYCyKbM7\n"
    "7tH3JqtIlPrHhtXDbliHWykCgYAahZPPRksYmfFQ6ftJ7owz1yPFcr1mHnLQ0m0j\n"
    "4vn/Xp4bEtqaXSGIK2z7Rl3yOkWOd2TVecLWkHMHw5HH+0btLz0iCsYEaAkB0Zq4\n"
    "iK3f2l3hQO93vFLPI0g0icFECh/evPOR8MlP8c6hdszOqanoTMij+D4gf0f0MCg3\n"
    "PbRxUQKBgQCCJZh4n3BJMwSmTskSK4hdKfF5Uw70jOElHXo6w8NjSfwv7pYnL4g5\n"
    "jx0+uW6L1l+DYuq5Lxh/rTYxF1H0fNq0jhW2QA/WPQQuWVCKQXvdxWR992K55Z1S\n"
    "rKul+CoUzMuBP0vFjoNfS527R7bLz/jKWvgr67XuSIt6NYmQGLsHzQ==\n"
    "-----END RSA PRIVATE KEY-----";

WiFiClientSecure client;

void setup()
{
  // Initialize serial and wait for port to open:
  Serial.begin(115200);
  delay(100);

  Serial.print("Attempting to connect to SSID: ");
  Serial.println(ssid);
  WiFi.begin(ssid, password);

  // attempt to connect to Wifi network:
  while (WiFi.status() != WL_CONNECTED)
  {
    Serial.print(".");
    // wait 1 second for re-trying
    delay(1000);
  }

  Serial.print("Connected to ");
  Serial.println(ssid);

  client.setCACert(test_root_ca);
  // client.setCertificate(test_client_cert); // for client verification
  // client.setPrivateKey(test_client_key);	// for client verification

  Serial.println("\nStarting connection to server...");
  if (!client.connect(server, 443))
    Serial.println("Connection failed!");
  else
  {
    Serial.println("Connected to server!");

    while (client.connected())
    {
      String line = client.readStringUntil('\n');
      if (line == "\r")
      {
        Serial.println("headers received");
        break;
      }
    }
    // if there are incoming bytes available
    // from the server, read them and print them:
    while (client.available())
    {
      char c = client.read();
      Serial.write(c);
    }

    client.stop();
  }
}

void loop()
{
  // do nothing
}
